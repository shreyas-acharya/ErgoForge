## boards/shields/inga/Kconfig.defconfig
```kconfig
if SHIELD_INGA_LEFT

config ZMK_KEYBOARD_NAME
    default "inga"

config ZMK_SPLIT_ROLE_CENTRAL
    default y

endif # SHIELD_INGA_LEFT

if SHIELD_INGA_LEFT || SHIELD_INGA_RIGHT

config ZMK_SPLIT
    default y

endif # SHIELD_INGA_LEFT || SHIELD_INGA_RIGHT
```

## boards/shields/inga/Kconfig.shield
```kconfig
config SHIELD_INGA_LEFT
    def_bool $(shields_list_contains,inga_left)

config SHIELD_INGA_RIGHT
    def_bool $(shields_list_contains,inga_right)
```
